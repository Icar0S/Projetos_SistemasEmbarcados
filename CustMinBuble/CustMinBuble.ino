//Uma função de utilidade para imprimir o conteúdo de arr apos a ORDENAÇÂO para teste de corretude
/*void printArray(int *array, int size)
  {
  for (int i = 0; i < size; i++) {
    Serial.print("  ");
    Serial.print(array[i]);
  }
  Serial.println();
  }*/

//--------------------------------------------------------------TESTE ARRAYS------------------------------------------------------------------------

int test900[] = { 286, 857, 672, 290, 124, 162, 879, 362, 848, 703, 775, 35, 227,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 600,
                  77, 511, 199, 517, 783, 430, 55, 96, 569, 699, 763, 496,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 559
                };

//int test500[] = {185, 57, 424, 104, 9, 66, 323, 69, 385, 4, 180, 26, 184,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 89, 431};

//int test300[] = {78, 270, 184, 12, 204, 287, 154, 299, 281, 263, 218, 51, 9,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 31, 116};

//int test200[] = {108, 86, 174, 3, 23, 143, 88, 129, 26, 160, 159, 78, 80,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 0, 166};

//int test3[] = {4544, 2343, 8342, 2347, 1230};
//int testinit[] = {56, 4, 3, 2, 6, 7, 12, 100, 101, 103, 77, 34};
//int test4[] = {4, 3, 2, 6};

//--------------------------------------------------------------TESTE ARRAYS-------------------------------------------------------------------------

//Uma função de utilidade para trocar dois elementos
void swap(int *a, int *b)
{
  //Serial.println(" SWAB");
  int t = *a;
  *a = *b;
  *b = t;
}

void bubbleSort(int *arr , int tamSize)
{
  int k;
  int j;
  int aux;

  for (k = 1; k < tamSize; k++) {
    for (j = 0; j < tamSize - 1; j++) {
      if (arr[j] < arr[j + 1]) {
        aux = arr[j];
        arr[j] = arr[j + 1];
        arr[j + 1] = aux;
      }
    }
  }
}


//--------------------------------------------------------------------FIM bubbleSort-------------------------------------------------------------------/

//joga o maior elemento para o final da fila
//armazena a fila final de resultado
// O(n)
void pushSorted(int element, int *array , int *tamSize)
{
  for (int i = 0; i < *tamSize; i++)
  {
    if (element >= array[i])
    {
      swap(&array[i], &element);
    }
  }
  array[*tamSize] = element;
  *tamSize += 1;
}

//Tempo constante de levar o maior para o final da fila  uint8_t uint16_t
uint32_t pop(int *array , int *tamSize )
{
  uint32_t last = array[*tamSize - 1];
  *tamSize -= 1;
  return last;
}

// O(n^2)
uint32_t minCost(int *array, int tamSize)
{
  uint32_t cost = 0;

  bubbleSort(array, tamSize);
  //printArray(array, tamSize);
  //Serial.println("Resultado de cada custo por conexao: ");
  while (tamSize > 1)
  {
    int first = pop(array, &tamSize); //O(1)
    int second = pop(array, &tamSize); //O(1)
    uint32_t result = first + second;
    //Serial.println(result);
    cost += result;
    pushSorted(result, array, &tamSize); // O(n)
  }

  return cost;
}




void setup()
{
  Serial.begin(9600);
  unsigned long timeBe = micros();
  uint32_t tamSize = 900;
  uint32_t result = minCost(test900, tamSize);
  //Serial.println(F(" Resultado de custo total:  "));
  Serial.println(result);
  unsigned long timeEn = micros();

  unsigned long duration = timeEn - timeBe;
  double durationT = (double)duration / 1000000.0;
 
  //imprime o tempo desde que o programa iniciou, em milissegundos
  Serial.print("Tempo:\n");
  Serial.println(durationT);

}

void loop() {
  //
}
